#include "Freenove_VK16K33_Lib_For_ESP32.h"
#include "Emotion.h"

#define  A  15
int emotion_mode = 0;
int arrow_mode = 0;

//Turn your eyes clockwise
byte eyeRotate1[][8]  = {
  0x00, 0x3C, 0x4E, 0x4E, 0x7E, 0x7E, 0x3C, 0x00,
  0x00, 0x3C, 0x66, 0x66, 0x7E, 0x7E, 0x3C, 0x00,
  0x00, 0x3C, 0x72, 0x72, 0x7E, 0x7E, 0x3C, 0x00,
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  0x00, 0x3C, 0x7E, 0x4E, 0x4E, 0x7E, 0x3C, 0x00,
};

//Turn your eyes counterclockwise
byte eyeRotate2[][8] = {
  0x00, 0x3C, 0x72, 0x72, 0x7E, 0x7E, 0x3C, 0x00,
  0x00, 0x3C, 0x66, 0x66, 0x7E, 0x7E, 0x3C, 0x00,
  0x00, 0x3C, 0x4E, 0x4E, 0x7E, 0x7E, 0x3C, 0x00,
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  0x00, 0x3C, 0x7E, 0x72, 0x72, 0x7E, 0x3C, 0x00,
};

byte eyeBlink[][8] = {
  0x00, 0x00, 0x3C, 0x66, 0x42, 0x66, 0x3C, 0x00,
  0x00, 0x00, 0x3C, 0x7E, 0x42, 0x66, 0x3C, 0x00,
  0x00, 0x00, 0x3C, 0x7E, 0x7E, 0x7E, 0x3C, 0x00,
  0x00, 0x00, 0x3C, 0x7E, 0x42, 0x66, 0x3C, 0x00,
  0x00, 0x00, 0x3C, 0x7E, 0x7E, 0x7E, 0x3C, 0x00,
};
byte eyeBlink1[][8] = {
  0x00, 0x18, 0x24, 0x5A, 0x42, 0x3C, 0x00, 0x00,
  0x00, 0x18, 0x24, 0x42, 0x42, 0x3C, 0x00, 0x00,
  0x00, 0x18, 0x24, 0x5A, 0x42, 0x3C, 0x00, 0x00,
  0x00, 0x18, 0x24, 0x42, 0x42, 0x3C, 0x00, 0x00,
};

byte eyeSmile[][8] = {
  0x00, 0x00, 0x18, 0x24, 0x42, 0x00, 0x00, 0x00,
  0x00, 0x18, 0x24, 0x42, 0x00, 0x00, 0x00, 0x00,
};

byte eyeCry1[][8] = {
  0x00, 0x00, 0x7E, 0x3C, 0x00, 0x00, 0x00, 0x00,
  0x00, 0x00, 0x7E, 0x3C, 0x18, 0x00, 0x00, 0x00,
  0x00, 0x00, 0x7E, 0x3C, 0x00, 0x18, 0x00, 0x00,
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  0x00, 0x00, 0x7E, 0x3C, 0x00, 0x00, 0x00, 0x00,
};

byte eyeCry2[][8] = {
  0x00, 0x00, 0x7E, 0x3C, 0x00, 0x00, 0x00, 0x00,
  0x00, 0x00, 0x7E, 0x3C, 0x00, 0x00, 0x00, 0x00,
  0x00, 0x00, 0x7E, 0x3C, 0x00, 0x00, 0x00, 0x00,
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  0x00, 0x00, 0x7E, 0x3C, 0x00, 0x00, 0x00, 0x00,
};

byte arrow_up[8][8] =
{
  {0, 0, 0, A, A, 0, 0, 0},
  {0, 0, A, A, A, A, 0, 0},
  {0, A, 0, A, A, 0, A, 0},
  {0, 0, 0, A, A, 0, 0, 0},
  {0, 0, 0, A, A, 0, 0, 0},
  {0, 0, 0, A, A, 0, 0, 0},
  {0, 0, 0, A, A, 0, 0, 0},
  {0, 0, 0, A, A, 0, 0, 0},
};
byte arrow_dowm[8][8] =
{
  {0, 0, 0, A, A, 0, 0, 0},
  {0, 0, 0, A, A, 0, 0, 0},
  {0, 0, 0, A, A, 0, 0, 0},
  {0, 0, 0, A, A, 0, 0, 0},
  {0, 0, 0, A, A, 0, 0, 0},
  {0, A, 0, A, A, 0, A, 0},
  {0, 0, A, A, A, A, 0, 0},
  {0, 0, 0, A, A, 0, 0, 0},
};
byte arrow_left[8][8] =
{
  {0, 0, 0, 0, 0, 0, 0, 0},
  {0, 0, A, 0, 0, 0, 0, 0},
  {0, A, 0, 0, 0, 0, 0, 0},
  {A, A, A, A, A, A, A, A},
  {A, A, A, A, A, A, A, A},
  {0, A, 0, 0, 0, 0, 0, 0},
  {0, 0, A, 0, 0, 0, 0, 0},
  {0, 0, 0, 0, 0, 0, 0, 0},
};
byte arrow_right[8][8] =
{
  {0, 0, 0, 0, 0, 0, 0, 0},
  {0, 0, 0, 0, 0, A, 0, 0},
  {0, 0, 0, 0, 0, 0, A, 0},
  {A, A, A, A, A, A, A, A},
  {A, A, A, A, A, A, A, A},
  {0, 0, 0, 0, 0, 0, A, 0},
  {0, 0, 0, 0, 0, A, 0, 0},
  {0, 0, 0, 0, 0, 0, 0, 0},
};

Freenove_ESP32_VK16K33 matrix = Freenove_ESP32_VK16K33();

void show_arrow(int arrow_direction)
{
  arrow_direction = constrain(arrow_direction, 0, 5);

  if (arrow_direction == 1)
  {
    for (int j = -8; j <= 8; j++)
    {
        matrix.showLedMatrix(arrow_up, 4, j);
        delay(100);
    }
  }
  if (arrow_direction == 2)
  {
    for (int j = 8; j >= -8; j--)
    {
        matrix.showLedMatrix(arrow_dowm, 4, j);
        delay(100);
    }
  }
  if (arrow_direction == 3)
  {
      for (int i = 8; i >= 0; i--)
      {
        matrix.showLedMatrix(arrow_left, i, 0);
        delay(100);
      }
  }
  if (arrow_direction == 4)
  {
      for (int i = 0; i <= 8; i++)
      {
        matrix.showLedMatrix(arrow_right, i, 0);
        delay(100);
      }
  }
}

//Turn the eyes
void eyesRotate(int delay_ms)
{
  int count = sizeof(eyeRotate1) / sizeof(eyeRotate1[0]);
  for (int i = 0; i < count; i++)
  {
    matrix.showStaticArray(eyeRotate1[i], eyeRotate2[i]);
    delay(delay_ms);
  }
}

//Wink the eyes
void eyesBlink(int delay_ms)
{
  int count = sizeof(eyeBlink) / sizeof(eyeBlink[0]);
  matrix.showStaticArray(eyeBlink[0], eyeBlink[0]);
  delay(2500);
  for (int j = 0; j < 1; j++)
  {
    for (int i = 1; i < count; i++)
    {
      matrix.showStaticArray(eyeBlink[i], eyeBlink[i]);
      delay(delay_ms);
    }
  }
}
//Wink the eyes
void eyesBlink1(int delay_ms)
{
  int count = sizeof(eyeBlink1) / sizeof(eyeSmile[0]);
  matrix.showStaticArray(eyeBlink1[0], eyeBlink1[0]);
  delay(800);
  for (int i = 0; i < count; i++)
  {
    matrix.showStaticArray(eyeBlink1[i], eyeBlink1[i]);
    delay(delay_ms);
  }
}

//Smile
void eyesSmile(int delay_ms)
{
  int count = sizeof(eyeSmile) / sizeof(eyeSmile[0]);
  for (int i = 0; i < count; i++)
  {
    matrix.showStaticArray(eyeSmile[i], eyeSmile[i]);
    delay(delay_ms);
  }
}

//Cry
void eyesCry(int delay_ms)
{
  int count = sizeof(eyeCry1) / sizeof(eyeCry1[0]);
  for (int i = 0; i < count; i++)
  {
    matrix.showStaticArray(eyeCry1[i], eyeCry2[i]);
    delay(delay_ms);
  }
}

//Initialize
void Emotion_Setup()
{
  matrix.init(EMOTION_ADDRESS, EMOTION_SDA, EMOTION_SCL);
  xTaskCreatePinnedToCore(Emotion_Show,  "Emotion_Show",  8192,  NULL,  1,  NULL ,  0);
}

void emotion_set_task_mode(int task_mode)
{
  emotion_mode = task_mode;
}

void arrow_set_mode(int mode)
{
  arrow_mode = mode;
}

//Expression shows
void Emotion_Show(void* pvParameters)
{
  while (1)
  {
    if (emotion_mode == 1)
      eyesRotate(150);
    else if (emotion_mode == 2)
      eyesBlink(100);
    else if (emotion_mode == 3)
      eyesSmile(200);
    else if (emotion_mode == 4)
      eyesCry(200);
    else if (emotion_mode == 5)
      eyesBlink1(200);
    else if (emotion_mode == 6)
      show_arrow(arrow_mode);
    else if (emotion_mode == 0)
      matrix.clear();
  }
}
